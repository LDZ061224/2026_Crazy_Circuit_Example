/*************************************************
Copyright (C), 2016-2020, TYUT JBD TEAM C.
File name: ssd1306.c
Author: TEAM  A B C
Version:0.0               Date: 2016.11.12
Description:    ssd1306
Others:      无
Function List: 1.OLED_Cmd
               2.OLED_Dat
               3.OLED_Init
               4.OLED_SetPos
               5.OLED_Fill
               6.OLED_CLS          OLED清屏
               7.OLED_ONE_Number
               8.OLED_Numbers      OLED显示数字
               9.OLED_ShowStr      OLED显示字符串
               10.Image_Displag    图像显示
History:
<author>  <time>      <version > <desc>
JBD       2016.10.21  0.0        初始
AmaZzzing 2016.11.12  1.0        初步完成构架
双车&信标   2020.6.1    儿童节版      兼容英飞凌
**************************************************/
#include "OLED.h"
#include "i2c.h"
#include "IIC.h"

/****************************OLED变量*****************************/
int LCD_TenThousand=0,LCD_Thousand=0,LCD_Hundred=0,LCD_Ten=0,LCD_Single=0;//万千百十个位
const unsigned char F6x8[][6] =
{
    {0x00, 0x00, 0x00, 0x00, 0x00, 0x00},// sp
    {0x00, 0x00, 0x00, 0x2f, 0x00, 0x00},// !
    {0x00, 0x00, 0x07, 0x00, 0x07, 0x00},// "
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    {0x14, 0x14, 0x14, 0x14, 0x14, 0x14},// horiz lines
};
/****************************************8*16μ?μ??ó************************************/
const unsigned char F8X16[]=
{
  0x00,0x00,0x00,0x00,0x00,0x00,0x00,0x00,0x00,0x00,0x00,0x00,0x00,0x00,0x00,0x00,// 0
  0x00,0x00,0x00,0xF8,0x00,0x00,0x00,0x00,0x00,0x00,0x00,0x33,0x30,0x00,0x00,0x00,//! 1
  0x00,0x10,0x0C,0x06,0x10,0x0C,0x06,0x00,0x00,0x00,0x00,0x00,0x00,0x00,0x00,0x00,//" 2
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  0x00,0x06,0x01,0x01,0x02,0x02,0x04,0x04,0x00,0x00,0x00,0x00,0x00,0x00,0x00,0x00,//~ 94
};

/*************************************************
Function: OLED_Cmd
Description:IIC写命令
Details：写命令首先传输（0x78）8位地址码，然后传输
        （0x00）8位命令信号，然后传输OLED_Cmd8位命
         令，具体开始、应答、结束信号产生时刻见如
         下程序
*************************************************/
void OLED_Cmd(unsigned char OLED_Cmd)
{
    I2c_Start();
    I2c_Write_OneByte(0x78);                            //OLED从器件地址
    I2C_Wait_Ask();
    I2c_Write_OneByte(0x00);                            //0x00=0000 0000
    I2C_Wait_Ask();
    I2c_Write_OneByte(OLED_Cmd);
    I2C_Wait_Ask();
    I2c_Stop();
}
/*************************************************
Function: OLED_Dat
Description:IIC写数据
Details：写命令首先传输（0x78）8位地址码，然后传输
        （0x40）8位数据信号，然后传输OLED_Cmd8位命
         令，具体开始、应答、结束信号产生时刻见如
         下程序
*************************************************/
void OLED_Dat(unsigned char OLED_Cmd)
{
    I2c_Start();
    I2c_Write_OneByte(0x78);                            //OLED从器件地址
    I2C_Wait_Ask();
    I2c_Write_OneByte(0x40);                            //器件内单元地址  0x40=0100 0000
    I2C_Wait_Ask();
    I2c_Write_OneByte(OLED_Cmd);                        //将数据写入指定存储单元
    I2C_Wait_Ask();
    I2c_Stop();
}
/*************************************************
Function: OLED_Init
Description:OLED初始化
Details：
*************************************************/
void OLED_Init(void)
{
//  PIN_InitConfig(P02_2, PIN_MODE_OUTPUT, 0);//RES
	  /*Configure GPIO pins : PBPin PBPin PBPin */	
    OLED_IIC_SCL_INIT;
	OLED_IIC_SDA_INIT;
	OLED_IIC_SCL_L;
	OLED_IIC_SDA_L;	  

    OLED_IIC_SCL_H;
//    OLED_RST_LOW;
//    OLED_RST_HIGH;
    OLED_Cmd(0xae);//--turn off oled panel
    OLED_Cmd(0x00);//---set low column address
    OLED_Cmd(0x10);//---set high column address
    OLED_Cmd(0x40);//--set start line address  Set Mapping RAM Display Start Line (0x00~0x3F)
    OLED_Cmd(0x81);//--set contrast control register
    OLED_Cmd(0xcf); // Set SEG Output Current Brightness 0xcf
    OLED_Cmd(0xa0);//--Set SEG/Column Mapping     0xa0左右反置 0xa1正常
    OLED_Cmd(0xc0);//Set COM/Row Scan Direction   0xc0上下反置 0xc8正常
    OLED_Cmd(0xa6);//--set normal display
    OLED_Cmd(0xa8);//--set multiplex ratio(1 to 64)
    OLED_Cmd(0x3f);//--1/64 duty
    OLED_Cmd(0xd3);//-set display offset    Shift Mapping RAM Counter (0x00~0x3F)
    OLED_Cmd(0x00);//-not offset
    OLED_Cmd(0xd5);//--set display clock divide ratio/oscillator frequency
    OLED_Cmd(0x80);//--set divide ratio, Set Clock as 100 Frames/Sec
    OLED_Cmd(0xd9);//--set pre-charge period
    OLED_Cmd(0xf1);//Set Pre-Charge as 15 Clocks & Discharge as 1 Clock
    OLED_Cmd(0xda);//--set com pins hardware configuration
    OLED_Cmd(0x12);
    OLED_Cmd(0xdb);//--set vcomh
    OLED_Cmd(0x40);//Set VCOM Deselect Level
    OLED_Cmd(0x20);//-Set Page Addressing Mode (0x00/0x01/0x02)
    OLED_Cmd(0x02);//
    OLED_Cmd(0x8d);//--set Charge Pump enable/disable
    OLED_Cmd(0x14);//--set(0x10) disable
    OLED_Cmd(0xa4);// Disable Entire Display On (0xa4/0xa5)
    OLED_Cmd(0xa6);// Disable Inverse Display On (0xa6/a7)
    OLED_Cmd(0xaf);//--turn on oled panel
    OLED_Fill(0x00);

    uint8_t  tempSector = 0;
}
/*************************************************
Function: OLED_SetPos
Description:定位一个坐标点
Details：定位一个坐标点作为显示一个字符最左上方像素
         点的坐标，x为横坐标（0-127）,y由上至下为纵
         坐标（0-7），每一纵坐标对应8个纵向分辨率。
*************************************************/
void OLED_SetPos(unsigned char x,unsigned char y)
{
    OLED_Cmd(0xb0+y);
    OLED_Cmd(((x&0xf0)>>4)|0x10);
    OLED_Cmd((x&0x0f)|0x01);
}
/*************************************************
Function: OLED_Fill
Description:填充数据
Detail:将整个OLED屏上的128*64个像素点填满fill_Data
       这个数据
*************************************************/
void OLED_Fill(unsigned char fill_Data)
{
    unsigned char m,n;
    for(m=0;m<8;m++)
    {
        OLED_Cmd(0xb0+m);
        OLED_Cmd(0x00);
        OLED_Cmd(0x10);
        for(n=0;n<128;n++)
        {
            OLED_Dat(fill_Data);
        }
    }
}
/**************************************************
Function: OLED_ONE_Number
Description:OLED显示一个数字
Details:x、y为坐标，num为数字
**************************************************/
void OLED_ONE_Number(unsigned char x,unsigned char y,char num)
{
    num+=16;//为跳过前15行字符显示

    OLED_SetPos(x,y);
    int i = 0;
    for(i=0;i<8;i++)
        OLED_Dat(F8X16[num*16+i]);
    OLED_SetPos(x,y+1);

    for(i=0;i<8;i++)
        OLED_Dat(F8X16[num*16+i+8]);
}
/**************************************************
Function: OLED_Numbers
Description:OLED显示一串数字
Details:x、y为坐标，Value为数字
**************************************************/
void OLED_Numbers(unsigned char x,unsigned char y,int Value)
{
    char c=0,j=0;
    int LED_Num[4]={0};

    if(Value>=0)                                //正数
    {
        LED_Num[0] = (Value % 10000) / 1000;    //千位
        LED_Num[1] = (Value % 1000) / 100;       //百位
        LED_Num[2] = (Value % 100) / 10;             //十位
        LED_Num[3] =  Value % 10;                  //个位
    }

    for(c=0,j=0;j<4;x+=8,j++)
    {
        c = LED_Num[j];                          //数字转换
        if(x>120)                             //转到下一行
        {
            x=0;
            y++;
        }

        OLED_ONE_Number(x,y,c);
    }
}
/**************************************************
Function: OLED_ShowStr
Description:OLED显示一串字符
Details:x、y为坐标（x为行，y为列），ch[]为字符，TextSize为字符尺寸
        仅使用2号即8X16尺寸。
**************************************************/
void OLED_ShowStr(unsigned char x,unsigned char y,unsigned char ch[], unsigned char TextSize)
{
    unsigned char c=0,i=0,j=0;
    switch(TextSize)
    {
        case 1:
        {
            while(ch[j]!='\0')
            {
                c = ch[j] - 32;
                if(x > 126)
                {
                    x = 0;
                    y++;
                }

                OLED_SetPos(x,y);

                for(i=0;i<6;i++)
                OLED_Dat(F6x8[c][i]);
                x += 6;
                j++;
            }
        }
        break;
        case 2:
        {
            while(ch[j] != '\0')
            {
                c = ch[j] - 32;//转换到F8X16[]中对应的行数
                if(x > 120) //oled横行只有128个像素点，而一个字符在F8X16[]中需要8个像素点的宽度128-8=120
                {
                    x = 0;
                    y++;
                }
                OLED_SetPos(x,y);//给定坐标（上半部分）
                for(i=0;i<8;i++)//先显示上半部分
                OLED_Dat(F8X16[c*16+i]);
                OLED_SetPos(x,y+1);//给定坐标（下半部分）
                for(i=0;i<8;i++)//再显示下半部分
                OLED_Dat(F8X16[c*16+i+8]);
                x += 8;
                j++;
            }
    }
    break;
    }
}

/*************************************************************
**Function: Image_Displag
**Description: 显示图像
**Others: 
************************************************************/

void Image_Display(int kind)
{
    uint8_t date = 0;

    for(int i=0; i<8; i++)  //图像8bit合成
    {
        OLED_SetPos(0,i);//设置行扫描起点
        for(int m = 0; m < 120; m++)        // 122
        {
            date = Image_dis[i << 3][m]
                | Image_dis[(i << 3) | 0x01][m] << 1
                | Image_dis[(i << 3) | 0x02][m] << 2
                | Image_dis[(i << 3) | 0x03][m] << 3
                | Image_dis[(i << 3) | 0x04][m] << 4
                | Image_dis[(i << 3) | 0x05][m] << 5
                | Image_dis[(i << 3) | 0x06][m] << 6
                | Image_dis[(i << 3) | 0x07][m] << 7;
            OLED_Dat(date);
        }
    }
}
